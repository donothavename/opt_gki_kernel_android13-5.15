## files/arch/llvm/Kconfig
```kconfig
config LLVM_POLLY
        bool "Enable LLVM's polyhedral loop optimizer (Polly)"
        help
          This option enables LLVM's polyhedral loop optimizer known as Polly.
          Polly is able to optimize various loops throughout the kernel for
          maximum cache locality. This requires an LLVM toolchain explicitly
          compiled with Polly support.
```
