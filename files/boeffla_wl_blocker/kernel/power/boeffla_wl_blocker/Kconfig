## files/boeffla_wl_blocker/kernel/power/boeffla_wl_blocker/Kconfig
```kconfig
config	BOEFFLA_WL_BLOCKER
		bool "Boeffla generic wakelock blocker driver"
		depends on PM
		default N
```

## files/trace_printk/kernel/trace/trace_printk/Kconfig
```kconfig
if TRACING

config DISABLE_TRACE_PRINTK
	bool "Force disable trace_printk() usage"
	default y
	help
	  When trace_printk() is used in any of the kernel source, it enables
	  debugging functions which are not desired for production kernel.
	  Enabling this option will replace trace_printk() with pr_debug().

	  If in doubt, say Y.

endif
```
